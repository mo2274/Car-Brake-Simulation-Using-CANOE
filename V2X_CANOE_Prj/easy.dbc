VERSION "DNNBNNNYNNNNNNNNNNNNNNNNNNYYYNNNNNNNNNNNNN/4/%%%/4/'%**4NNN///"

NS_ :

BS_:

BU_: Car2_Brake Car2_Telematics Car1_Telematics Car1_Brake

BO_ 133 Car2_V2X_Intenal_DATA_Message: 8 Vector__XXX
 SG_ Car2_V2X_Intenal_DATA : 0|8@1- (1,0) [0|0] "" Vector__XXX

BO_ 128 Car1_V2X_Intenal_DATA_Message: 8 Vector__XXX
 SG_ Car1_V2X_Intenal_DATA : 0|8@1- (1,0) [0|0] "" Vector__XXX

BO_ 117 Car2_Telematic_V2X_Data: 8 Vector__XXX
 SG_ Car2_V2X_DATA : 0|8@1- (1,0) [0|0] "" Vector__XXX

BO_ 80 Car1_Telematic_V2X_Data: 8 Vector__XXX
 SG_ Car1_V2X_DATA : 0|8@1- (1,0) [0|0] "" Vector__XXX

BO_ 512 Car2_Brake_data: 8 Vector__XXX
 SG_ Car2_brake_frame_1 : 0|8@1- (1,0) [0|0] "" Vector__XXX

BO_ 256 Car1_Brake_DATA: 1 Vector__XXX
 SG_ Car1_brake_frame_1 : 0|8@1- (1,0) [0|0] "" Vector__XXX

EV_ car1_brake_happen: 0 [0|0] "" 0 1 DUMMY_NODE_VECTOR0 Vector__XXX;

EV_ car2_brake_status: 0 [0|0] "" 0 2 DUMMY_NODE_VECTOR0 Vector__XXX;

EV_ car2_brake_button: 0 [0|0] "" 0 3 DUMMY_NODE_VECTOR0 Vector__XXX;

EV_ car2_brake_happen: 0 [0|0] "" 0 4 DUMMY_NODE_VECTOR0 Vector__XXX;

EV_ car1_brake_button: 0 [0|0] "" 0 5 DUMMY_NODE_VECTOR0 Vector__XXX;

EV_ car1_brake_status: 0 [0|0] "" 0 6 DUMMY_NODE_VECTOR0 Vector__XXX;

BA_DEF_  "BusType" STRING ;
BA_DEF_ BU_  "ILUsed" ENUM  "Yes","No";
BA_DEF_ SG_  "GenSigSendType" ENUM  "Cyclic","OnWrite","OnWriteWithRepetition","OnChange","OnChangeWithRepetition","IfActive","IfActiveWithRepetition";
BA_DEF_ BO_  "GenMsgDelayTime" INT 1 1000;
BA_DEF_ BO_  "GenMsgCycleTime" INT 2 50000;
BA_DEF_ BO_  "GenMsgCycleTimeFast" INT 2 100000;
BA_DEF_ BO_  "GenMsgILSupport" ENUM  "No","Yes";
BA_DEF_ BU_  "NodeLayerModules" STRING ;
BA_DEF_DEF_  "BusType" "";
BA_DEF_DEF_  "ILUsed" "Yes";
BA_DEF_DEF_  "GenSigSendType" "Cyclic";
BA_DEF_DEF_  "GenMsgDelayTime" 1;
BA_DEF_DEF_  "GenMsgCycleTime" 2;
BA_DEF_DEF_  "GenMsgCycleTimeFast" 100;
BA_DEF_DEF_  "GenMsgILSupport" "Yes";
BA_DEF_DEF_  "NodeLayerModules" "CANoeILNLVector.dll";
BA_ "BusType" "CAN";
